AUTOSAR XML (schema 00046)
package /ActiveEcuC
  module config Os: implementation-config-variant=VARIANT-PRE-COMPILE, module-description=Os_Impl
    OsGeneral: OsShowNoMappingTask=false
    OSDEFAULTAPPMODE (OsAppMode)
    OSAUTOSTARTMODE (OsAppMode)
    3 x OsApplication, all with OsTrusted=true, OsIsPrivileged=true, OsTrustedApplicationDelayTimingViolationCall=true, OsTrustedApplicationWithProtection=false, OsAppMemoryProtectionIdentifier=(unset), OsAppScheduleTableRef=(unset), OsRestartTask=(unset):
      SystemApplication_Core{0..2}: OsAppAlarmRef=/ActiveEcuC/Os/OsAlarm_Systick_Core{0..2}, OsAppCounterRef=/ActiveEcuC/Os/SystemTimer{0..2}, OsAppEcucPartitionRef=/ActiveEcuC/EcuC/EcucPartitionCollection/EcucPartition_{0..2}, OsAppIsrRef=/ActiveEcuC/Os/OS_ISR_SYSTICK_CORE{0..2}, OsApplicationCoreRef=/ActiveEcuC/EcuC/EcucHardware/EcucCoreDefinition{0..2}, OsAppTaskRef=/ActiveEcuC/Os/core{0..2}_shell, OsAppIsrRef=/ActiveEcuC/Os/OS_ISR_IPICALL_CORE{0..2}, OsAppIsrRef=/ActiveEcuC/Os/Os_ISR_UART_CORE{0..2}
    4 x OsTask, all with OsTaskWithProtection=false, OsTaskUsesFpu=true, OsTaskActivation=1, OsTaskPriority=5, OsTaskStackSize=2048, OsTaskTicksToWait=4294967295, OsTaskStackSharing=false, OsTaskSchedule=FULL, OsTaskType=EXTENDED, OsMemoryMappingCodeLocationRef=(unset), OsTaskEventRef=(unset), OsTaskResourceRef=(unset):
      core0_shell: OsTaskAccessingApplication=/ActiveEcuC/Os/SystemApplication_Core0
        OsTaskAutostart: OsTaskAppModeRef=/ActiveEcuC/Os/OSAUTOSTARTMODE
      core1_shell: OsTaskAccessingApplication=/ActiveEcuC/Os/SystemApplication_Core1
        OsTaskAutostart: OsTaskAppModeRef=/ActiveEcuC/Os/OSAUTOSTARTMODE
      core2_shell: OsTaskAccessingApplication=/ActiveEcuC/Os/SystemApplication_Core2
        OsTaskAutostart: OsTaskAppModeRef=/ActiveEcuC/Os/OSAUTOSTARTMODE
      core3_shell: OsTaskAccessingApplication=/ActiveEcuC/Os/SystemApplication_Core3
        OsTaskAutostart: OsTaskAppModeRef=/ActiveEcuC/Os/OSAUTOSTARTMODE
    SystemApplication_Core3 (OsApplication):
      OsTrusted = true
      OsIsPrivileged = true
      OsTrustedApplicationDelayTimingViolationCall = true
      OsTrustedApplicationWithProtection = false
      OsAppMemoryProtectionIdentifier = (unset)
      OsAppAlarmRef = /ActiveEcuC/Os/OsAlarm_Systick_Core3
      OsAppCounterRef = /ActiveEcuC/Os/SystemTimer3
      OsAppEcucPartitionRef = /ActiveEcuC/EcuC/EcucPartitionCollection/EcucPartition_3
      OsAppIsrRef = /ActiveEcuC/Os/OS_ISR_SYSTICK_CORE3
      OsApplicationCoreRef = /ActiveEcuC/EcuC/EcucHardware/EcucCoreDefinition3
      OsAppScheduleTableRef = (unset)
      OsRestartTask = (unset)
      OsAppTaskRef = /ActiveEcuC/Os/core3_shell
      OsAppIsrRef = /ActiveEcuC/Os/OS_ISR_IPICALL_CORE3
      OsAppIsrRef = /ActiveEcuC/Os/Os_ISR_UART_CORE3
    TriCore397 (OsPublishedInformation): OsKernelVersion=1.0.0, OsPlatformName=AURIX TC3XX
      OsDerivativeInformation: OsMpuAlignment=32, OsStackAlignment=4
        OsPhysicalCore0 (OsPhysicalCore): OsPhysicalCoreId=0
        STM0 (OsHardWareTimer): OsHardWareTimerClockFrequency=100, OsHardWareTimerChannel=STM0
        5 x OsPhysicalCore:
          OsPhysicalCore{1..5}: OsPhysicalCoreId={1..5}
        5 x OsHardWareTimer, all with OsHardWareTimerClockFrequency=100:
          STM{1..5}: OsHardWareTimerChannel=STM{1..5}
    4 x OsCounter, all with OsSecondsPerTick=0.00000001, OsCounterMaxAllowedValue=1073741823, OsCounterMinCycle=1, OsCounterTicksPerBase=(unset), OsCounterType=HARDWARE:
      SystemTimer0: OsCounterAccessingApplication=/ActiveEcuC/Os/SystemApplication_Core0
        OsDriver:
          High Resolution = true
          OsGptChannelRef = (unset)
          OsIsrRef = /ActiveEcuC/Os/OS_ISR_SYSTICK_CORE0
          OsHardwareTimerChannelRef = /ActiveEcuC/Os/TriCore397/OsDerivativeInformation/STM0
      SystemTimer1: OsCounterAccessingApplication=/ActiveEcuC/Os/SystemApplication_Core1
        OsDriver:
          High Resolution = true
          OsGptChannelRef = (unset)
          OsIsrRef = /ActiveEcuC/Os/OS_ISR_SYSTICK_CORE1
          OsHardwareTimerChannelRef = /ActiveEcuC/Os/TriCore397/OsDerivativeInformation/STM1
      SystemTimer2: OsCounterAccessingApplication=/ActiveEcuC/Os/SystemApplication_Core2
        OsDriver:
          High Resolution = true
          OsGptChannelRef = (unset)
          OsIsrRef = /ActiveEcuC/Os/OS_ISR_SYSTICK_CORE2
          OsHardwareTimerChannelRef = /ActiveEcuC/Os/TriCore397/OsDerivativeInformation/STM2
      SystemTimer3: OsCounterAccessingApplication=/ActiveEcuC/Os/SystemApplication_Core3
        OsDriver:
          High Resolution = true
          OsGptChannelRef = (unset)
          OsIsrRef = /ActiveEcuC/Os/OS_ISR_SYSTICK_CORE3
          OsHardwareTimerChannelRef = /ActiveEcuC/Os/TriCore397/OsDerivativeInformation/STM3
    12 x OsIsr, all with OsIsrCategory=CATEGORY_2, OsMemoryMappingCodeLocationRef=(unset), OsIsrResourceRef=(unset):
      OS_ISR_SYSTICK_CORE0: OsIsrInitialEnableInterruptSource=false, OsIsrInterruptPriority=1, OsIsrInterruptSource=768, OsIsrEntryFunctionName=core0_systick_handler
      OS_ISR_SYSTICK_CORE1: OsIsrInitialEnableInterruptSource=false, OsIsrInterruptPriority=1, OsIsrInterruptSource=776, OsIsrEntryFunctionName=core1_systick_handler
      OS_ISR_SYSTICK_CORE2: OsIsrInitialEnableInterruptSource=false, OsIsrInterruptPriority=1, OsIsrInterruptSource=784, OsIsrEntryFunctionName=core2_systick_handler
      OS_ISR_SYSTICK_CORE3: OsIsrInitialEnableInterruptSource=false, OsIsrInterruptPriority=1, OsIsrInterruptSource=792, OsIsrEntryFunctionName=core3_systick_handler
      OS_ISR_IPICALL_CORE0: OsIsrInitialEnableInterruptSource=true, OsIsrInterruptPriority=11, OsIsrInterruptSource=2448, OsIsrEntryFunctionName=up_ipicall_isr_handler
      OS_ISR_IPICALL_CORE1: OsIsrInitialEnableInterruptSource=true, OsIsrInterruptPriority=11, OsIsrInterruptSource=2452, OsIsrEntryFunctionName=up_ipicall_isr_handler
      OS_ISR_IPICALL_CORE2: OsIsrInitialEnableInterruptSource=true, OsIsrInterruptPriority=11, OsIsrInterruptSource=2456, OsIsrEntryFunctionName=up_ipicall_isr_handler
      OS_ISR_IPICALL_CORE3: OsIsrInitialEnableInterruptSource=true, OsIsrInterruptPriority=11, OsIsrInterruptSource=2460, OsIsrEntryFunctionName=up_ipicall_isr_handler
      Os_ISR_UART_CORE{0..3}: OsIsrInitialEnableInterruptSource=false, OsIsrInterruptPriority=2, OsIsrInterruptSource=84, OsIsrEntryFunctionName=up_uart_rx_handler
    OsOS:
      OsStackMonitoring = (unset)
      OsUseGetServiceId = (unset)
      OsUseParameterAccess = (unset)
      OsUseResScheduler = true
      OsNumberOfCores = (unset)
      OsIpiCallQueueDepth = 5
      OsUsePreStartTask = false
      OsScalabilityClass = (unset)
      OsStatus = EXTENDED
      OsHooks:
        OsErrorHook = true
        OsPostTaskHook = true
        OsPreTaskHook = true
        OsIdleHook = true
        OsProtectionHook = false
        OsShutdownHook = true
        OsStartupHook = true
        OsErrorHookStackSize = 1024
        OsProtectionHookStackSize = 1024
        OsShutdownHookStackSize = 1024
        OsStartupHookStackSize = 1024
        OsMemoryMappingCodeLocationRef = (unset)
      OsArti:
        OsArtiEnabled = false
        OsArtiTaskTrace = false
        OsArtiResourceTrace = false
        OsArtiSpinlockTrace = false
        OsArtiIntTrace = false
        OsArtiCAT2ISRTTrace = false
        OsArtiRunnableTrace = false
    SystemApplication_Core4 (OsApplication):
      OsTrusted = true
      OsIsPrivileged = true
      OsTrustedApplicationDelayTimingViolationCall = true
      OsTrustedApplicationWithProtection = false
      OsAppMemoryProtectionIdentifier = (unset)
      OsAppAlarmRef = /ActiveEcuC/Os/OsAlarm_Systick_Core4
      OsAppCounterRef = /ActiveEcuC/Os/SystemTimer4
      OsAppEcucPartitionRef = /ActiveEcuC/EcuC/EcucPartitionCollection/EcucPartition_4
      OsApplicationCoreRef = /ActiveEcuC/EcuC/EcucHardware/EcucCoreDefinition4
      OsAppScheduleTableRef = (unset)
      OsRestartTask = (unset)
      OsAppIsrRef = /ActiveEcuC/Os/OS_ISR_SYSTICK_CORE4
      OsAppTaskRef = /ActiveEcuC/Os/core4_shell
      OsAppIsrRef = /ActiveEcuC/Os/OS_ISR_IPICALL_CORE4
      OsAppIsrRef = /ActiveEcuC/Os/Os_ISR_UART_CORE4
    SystemApplication_Core5 (OsApplication):
      OsTrusted = true
      OsIsPrivileged = true
      OsTrustedApplicationDelayTimingViolationCall = true
      OsTrustedApplicationWithProtection = false
      OsAppMemoryProtectionIdentifier = (unset)
      OsAppAlarmRef = /ActiveEcuC/Os/OsAlarm_Systick_Core5
      OsAppCounterRef = /ActiveEcuC/Os/SystemTimer5
      OsAppEcucPartitionRef = /ActiveEcuC/EcuC/EcucPartitionCollection/EcucPartition_5
      OsApplicationCoreRef = /ActiveEcuC/EcuC/EcucHardware/EcucCoreDefinition5
      OsAppScheduleTableRef = (unset)
      OsRestartTask = (unset)
      OsAppIsrRef = /ActiveEcuC/Os/OS_ISR_SYSTICK_CORE5
      OsAppTaskRef = /ActiveEcuC/Os/core5_shell
      OsAppIsrRef = /ActiveEcuC/Os/OS_ISR_IPICALL_CORE5
      OsAppIsrRef = /ActiveEcuC/Os/Os_ISR_UART_CORE5
    SystemTimer4 (OsCounter):
      OsSecondsPerTick = 0.00000001
      OsCounterMaxAllowedValue = 1073741823
      OsCounterMinCycle = 1
      OsCounterTicksPerBase = (unset)
      OsCounterType = HARDWARE
      OsCounterAccessingApplication = /ActiveEcuC/Os/SystemApplication_Core4
      OsDriver:
        High Resolution = true
        OsGptChannelRef = (unset)
        OsIsrRef = /ActiveEcuC/Os/OS_ISR_SYSTICK_CORE4
        OsHardwareTimerChannelRef = /ActiveEcuC/Os/TriCore397/OsDerivativeInformation/STM4
    SystemTimer5 (OsCounter):
      OsSecondsPerTick = 0.00000001
      OsCounterMaxAllowedValue = 1073741823
      OsCounterMinCycle = 1
      OsCounterTicksPerBase = (unset)
      OsCounterType = HARDWARE
      OsCounterAccessingApplication = /ActiveEcuC/Os/SystemApplication_Core5
      OsDriver:
        High Resolution = true
        OsGptChannelRef = (unset)
        OsIsrRef = /ActiveEcuC/Os/OS_ISR_SYSTICK_CORE5
        OsHardwareTimerChannelRef = /ActiveEcuC/Os/TriCore397/OsDerivativeInformation/STM5
    core4_shell (OsTask):
      OsTaskWithProtection = false
      OsTaskUsesFpu = true
      OsTaskActivation = 1
      OsTaskPriority = 5
      OsTaskStackSize = 2048
      OsTaskTicksToWait = 4294967295
      OsTaskStackSharing = false
      OsTaskSchedule = FULL
      OsTaskType = EXTENDED
      OsMemoryMappingCodeLocationRef = (unset)
      OsTaskAccessingApplication = /ActiveEcuC/Os/SystemApplication_Core4
      OsTaskEventRef = (unset)
      OsTaskResourceRef = (unset)
      OsTaskAutostart: OsTaskAppModeRef=/ActiveEcuC/Os/OSAUTOSTARTMODE
    core5_shell (OsTask):
      OsTaskWithProtection = false
      OsTaskUsesFpu = true
      OsTaskActivation = 1
      OsTaskPriority = 5
      OsTaskStackSize = 2048
      OsTaskTicksToWait = 4294967295
      OsTaskStackSharing = false
      OsTaskSchedule = FULL
      OsTaskType = EXTENDED
      OsMemoryMappingCodeLocationRef = (unset)
      OsTaskAccessingApplication = /ActiveEcuC/Os/SystemApplication_Core5
      OsTaskEventRef = (unset)
      OsTaskResourceRef = (unset)
      OsTaskAutostart: OsTaskAppModeRef=/ActiveEcuC/Os/OSAUTOSTARTMODE
    6 x OsIsr, all with OsIsrCategory=CATEGORY_2, OsMemoryMappingCodeLocationRef=(unset), OsIsrResourceRef=(unset):
      OS_ISR_SYSTICK_CORE4: OsIsrInitialEnableInterruptSource=false, OsIsrInterruptPriority=1, OsIsrInterruptSource=800, OsIsrEntryFunctionName=core4_systick_handler
      OS_ISR_SYSTICK_CORE5: OsIsrInitialEnableInterruptSource=false, OsIsrInterruptPriority=1, OsIsrInterruptSource=808, OsIsrEntryFunctionName=core5_systick_handler
      OS_ISR_IPICALL_CORE4: OsIsrInitialEnableInterruptSource=true, OsIsrInterruptPriority=11, OsIsrInterruptSource=2464, OsIsrEntryFunctionName=up_ipicall_isr_handler
      OS_ISR_IPICALL_CORE5: OsIsrInitialEnableInterruptSource=true, OsIsrInterruptPriority=11, OsIsrInterruptSource=2468, OsIsrEntryFunctionName=up_ipicall_isr_handler
      Os_ISR_UART_CORE4: OsIsrInitialEnableInterruptSource=false, OsIsrInterruptPriority=2, OsIsrInterruptSource=84, OsIsrEntryFunctionName=up_uart_rx_handler
      Os_ISR_UART_CORE5: OsIsrInitialEnableInterruptSource=false, OsIsrInterruptPriority=2, OsIsrInterruptSource=84, OsIsrEntryFunctionName=up_uart_rx_handler
    6 x OsAlarm, all with OsAlarmAccessingApplication=(unset):
      OsAlarm_Systick_Core0: OsAlarmCounterRef=/ActiveEcuC/Os/SystemTimer0
        OsAlarmAction
          OsAlarmCallback: OsAlarmCallbackName=FreeRTOS_Tick_Handler_Core0
        OsAlarmAutostart: OsAlarmAlarmTime=100000, OsAlarmCycleTime=100000, OsAlarmAutostartType=RELATIVE, OsAlarmAppModeRef=/ActiveEcuC/Os/OSAUTOSTARTMODE
      OsAlarm_Systick_Core1: OsAlarmCounterRef=/ActiveEcuC/Os/SystemTimer1
        OsAlarmAction
          OsAlarmCallback: OsAlarmCallbackName=FreeRTOS_Tick_Handler_Core1
        OsAlarmAutostart: OsAlarmAlarmTime=100000, OsAlarmCycleTime=100000, OsAlarmAutostartType=RELATIVE, OsAlarmAppModeRef=/ActiveEcuC/Os/OSAUTOSTARTMODE
      OsAlarm_Systick_Core2: OsAlarmCounterRef=/ActiveEcuC/Os/SystemTimer2
        OsAlarmAction
          OsAlarmCallback: OsAlarmCallbackName=FreeRTOS_Tick_Handler_Core1
        OsAlarmAutostart: OsAlarmAlarmTime=100000, OsAlarmCycleTime=100000, OsAlarmAutostartType=RELATIVE, OsAlarmAppModeRef=/ActiveEcuC/Os/OSAUTOSTARTMODE
      OsAlarm_Systick_Core3: OsAlarmCounterRef=/ActiveEcuC/Os/SystemTimer3
        OsAlarmAction
          OsAlarmCallback: OsAlarmCallbackName=FreeRTOS_Tick_Handler_Core3
        OsAlarmAutostart: OsAlarmAlarmTime=100000, OsAlarmCycleTime=100000, OsAlarmAutostartType=RELATIVE, OsAlarmAppModeRef=/ActiveEcuC/Os/OSAUTOSTARTMODE
      OsAlarm_Systick_Core4: OsAlarmCounterRef=/ActiveEcuC/Os/SystemTimer4
        OsAlarmAction
          OsAlarmCallback: OsAlarmCallbackName=FreeRTOS_Tick_Handler_Core4
        OsAlarmAutostart: OsAlarmAlarmTime=100000, OsAlarmCycleTime=100000, OsAlarmAutostartType=RELATIVE, OsAlarmAppModeRef=/ActiveEcuC/Os/OSAUTOSTARTMODE
      OsAlarm_Systick_Core5: OsAlarmCounterRef=/ActiveEcuC/Os/SystemTimer5
        OsAlarmAction
          OsAlarmCallback: OsAlarmCallbackName=FreeRTOS_Tick_Handler_Core5
        OsAlarmAutostart: OsAlarmAlarmTime=100000, OsAlarmCycleTime=100000, OsAlarmAutostartType=RELATIVE, OsAlarmAppModeRef=/ActiveEcuC/Os/OSAUTOSTARTMODE
    OsMemmoryMap
      rtfw (OsMemmapLayer): OsInternalLayer=true
    6 x OsCore:
      OsCore{0..5}: OsCoreBswApplicationRef=/ActiveEcuC/Os/SystemApplication_Core{0..5}
