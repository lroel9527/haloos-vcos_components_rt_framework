AUTOSAR XML (schema 00046)
package /ActiveEcuC
  module config Os: implementation-config-variant=VARIANT-PRE-COMPILE, module-description=Os_Impl
    OsGeneral: OsShowNoMappingTask=false
    OSDEFAULTAPPMODE (OsAppMode)
    OSAUTOSTARTMODE (OsAppMode)
    3 x OsApplication, all with OsTrusted=true, OsIsPrivileged=true, OsTrustedApplicationDelayTimingViolationCall=true, OsTrustedApplicationWithProtection=false, OsAppMemoryProtectionIdentifier=(unset), OsAppScheduleTableRef=(unset), OsRestartTask=(unset):
      SystemApplication_Core{0..2}: OsAppAlarmRef=/ActiveEcuC/Os/OsAlarm_Systick_Core{0..2}, OsAppCounterRef=/ActiveEcuC/Os/systemtimer{0..2}, OsAppEcucPartitionRef=/ActiveEcuC/EcuC/EcucPartitionCollection/EcucPartition_{0..2}, OsAppIsrRef=/ActiveEcuC/Os/core{0..2}_systick_isr, OsApplicationCoreRef=/ActiveEcuC/EcuC/EcucHardware/EcucCoreDefinition{0..2}, OsAppTaskRef=/ActiveEcuC/Os/core{0..2}_shell, OsAppIsrRef=/ActiveEcuC/Os/core{0..2}_ipicall_isr, OsAppIsrRef=/ActiveEcuC/Os/core{0..2}_uart_isr
    4 x OsTask, all with OsTaskWithProtection=false, OsTaskUsesFpu=true, OsTaskActivation=1, OsTaskPriority=5, OsTaskStackSize=2048, OsTaskTicksToWait=4294967295, OsTaskStackSharing=false, OsTaskSchedule=FULL, OsTaskType=EXTENDED, OsMemoryMappingCodeLocationRef=(unset), OsTaskEventRef=(unset), OsTaskResourceRef=(unset):
      core0_shell: OsTaskAccessingApplication=/ActiveEcuC/Os/SystemApplication_Core0
        OsTaskAutostart: OsTaskAppModeRef=/ActiveEcuC/Os/OSAUTOSTARTMODE
      core1_shell: OsTaskAccessingApplication=/ActiveEcuC/Os/SystemApplication_Core1
        OsTaskAutostart: OsTaskAppModeRef=/ActiveEcuC/Os/OSAUTOSTARTMODE
      core2_shell: OsTaskAccessingApplication=/ActiveEcuC/Os/SystemApplication_Core2
        OsTaskAutostart: OsTaskAppModeRef=/ActiveEcuC/Os/OSAUTOSTARTMODE
      core3_shell: OsTaskAccessingApplication=/ActiveEcuC/Os/SystemApplication_Core3
        OsTaskAutostart: OsTaskAppModeRef=/ActiveEcuC/Os/OSAUTOSTARTMODE
    SystemApplication_Core3 (OsApplication):
      OsTrusted = true
      OsIsPrivileged = true
      OsTrustedApplicationDelayTimingViolationCall = true
      OsTrustedApplicationWithProtection = false
      OsAppMemoryProtectionIdentifier = (unset)
      OsAppAlarmRef = /ActiveEcuC/Os/OsAlarm_Systick_Core3
      OsAppCounterRef = /ActiveEcuC/Os/systemtimer3
      OsAppEcucPartitionRef = /ActiveEcuC/EcuC/EcucPartitionCollection/EcucPartition_3
      OsAppIsrRef = /ActiveEcuC/Os/core3_systick_isr
      OsApplicationCoreRef = /ActiveEcuC/EcuC/EcucHardware/EcucCoreDefinition3
      OsAppScheduleTableRef = (unset)
      OsRestartTask = (unset)
      OsAppTaskRef = /ActiveEcuC/Os/core3_shell
      OsAppIsrRef = /ActiveEcuC/Os/core3_ipicall_isr
      OsAppIsrRef = /ActiveEcuC/Os/core3_uart_isr
    4 x OsCounter, all with OsSecondsPerTick=0.0000000416666666666667, OsCounterMaxAllowedValue=1073741823, OsCounterMinCycle=1, OsCounterTicksPerBase=(unset), OsCounterType=HARDWARE:
      systemtimer0: OsCounterAccessingApplication=/ActiveEcuC/Os/SystemApplication_Core0
        OsDriver:
          High Resolution = true
          OsGptChannelRef = (unset)
          OsIsrRef = /ActiveEcuC/Os/core0_systick_isr
          OsHardwareTimerChannelRef = /ActiveEcuC/Os/Armv8rE3650/OsDerivativeInformation/GTM0
      systemtimer1: OsCounterAccessingApplication=/ActiveEcuC/Os/SystemApplication_Core1
        OsDriver:
          High Resolution = true
          OsGptChannelRef = (unset)
          OsIsrRef = /ActiveEcuC/Os/core1_systick_isr
          OsHardwareTimerChannelRef = /ActiveEcuC/Os/Armv8rE3650/OsDerivativeInformation/GTM1
      systemtimer2: OsCounterAccessingApplication=/ActiveEcuC/Os/SystemApplication_Core2
        OsDriver:
          High Resolution = true
          OsGptChannelRef = (unset)
          OsIsrRef = /ActiveEcuC/Os/core2_systick_isr
          OsHardwareTimerChannelRef = /ActiveEcuC/Os/Armv8rE3650/OsDerivativeInformation/GTM2
      systemtimer3: OsCounterAccessingApplication=/ActiveEcuC/Os/SystemApplication_Core3
        OsDriver:
          High Resolution = true
          OsGptChannelRef = (unset)
          OsIsrRef = /ActiveEcuC/Os/core3_systick_isr
          OsHardwareTimerChannelRef = /ActiveEcuC/Os/Armv8rE3650/OsDerivativeInformation/GTM3
    12 x OsIsr, all with OsIsrCategory=CATEGORY_2, OsMemoryMappingCodeLocationRef=(unset), OsIsrResourceRef=(unset):
      core0_systick_isr: OsIsrInitialEnableInterruptSource=false, OsIsrInterruptPriority=1, OsIsrInterruptSource=30, OsIsrEntryFunctionName=core0_systick_handler
      core{1..3}_systick_isr: OsIsrInitialEnableInterruptSource=false, OsIsrInterruptPriority=12, OsIsrInterruptSource=30, OsIsrEntryFunctionName=core{1..3}_systick_handler
      core{0..3}_ipicall_isr: OsIsrInitialEnableInterruptSource=true, OsIsrInterruptPriority=10, OsIsrInterruptSource=0, OsIsrEntryFunctionName=up_ipicall_isr_handler
      core0_uart_isr: OsIsrInitialEnableInterruptSource=true, OsIsrInterruptPriority=14, OsIsrInterruptSource=114, OsIsrEntryFunctionName=up_uart_rx_handler
      core{1..3}_uart_isr: OsIsrInitialEnableInterruptSource=false, OsIsrInterruptPriority=14, OsIsrInterruptSource=114, OsIsrEntryFunctionName=up_uart_rx_handler
    OsOS:
      OsStackMonitoring = (unset)
      OsUseGetServiceId = (unset)
      OsUseParameterAccess = (unset)
      OsUseResScheduler = true
      OsNumberOfCores = (unset)
      OsIpiCallQueueDepth = 5
      OsUsePreStartTask = false
      OsScalabilityClass = (unset)
      OsStatus = EXTENDED
      OsHooks:
        OsErrorHook = true
        OsPostTaskHook = true
        OsPreTaskHook = true
        OsIdleHook = true
        OsProtectionHook = false
        OsShutdownHook = true
        OsStartupHook = true
        OsErrorHookStackSize = 1024
        OsProtectionHookStackSize = 1024
        OsShutdownHookStackSize = 1024
        OsStartupHookStackSize = 1024
        OsMemoryMappingCodeLocationRef = (unset)
      OsArti: OsArtiEnabled=false, OsArtiResourceTrace=false, OsArtiSpinlockTrace=false, OsArtiIntTrace=false, OsArtiCAT2ISRTTrace=false, OsArtiRunnableTrace=false
    6 x OsAlarm, all with OsAlarmAccessingApplication=(unset):
      OsAlarm_Systick_Core0: OsAlarmCounterRef=/ActiveEcuC/Os/systemtimer0
        OsAlarmAction
          OsAlarmCallback: OsAlarmCallbackName=FreeRTOS_Tick_Handler_Core0
        OsAlarmAutostart: OsAlarmAlarmTime=100000, OsAlarmCycleTime=100000, OsAlarmAutostartType=RELATIVE, OsAlarmAppModeRef=/ActiveEcuC/Os/OSAUTOSTARTMODE
      OsAlarm_Systick_Core1: OsAlarmCounterRef=/ActiveEcuC/Os/systemtimer1
        OsAlarmAction
          OsAlarmCallback: OsAlarmCallbackName=FreeRTOS_Tick_Handler_Core1
        OsAlarmAutostart: OsAlarmAlarmTime=100000, OsAlarmCycleTime=100000, OsAlarmAutostartType=RELATIVE, OsAlarmAppModeRef=/ActiveEcuC/Os/OSAUTOSTARTMODE
      OsAlarm_Systick_Core2: OsAlarmCounterRef=/ActiveEcuC/Os/systemtimer2
        OsAlarmAction
          OsAlarmCallback: OsAlarmCallbackName=FreeRTOS_Tick_Handler_Core1
        OsAlarmAutostart: OsAlarmAlarmTime=100000, OsAlarmCycleTime=100000, OsAlarmAutostartType=RELATIVE, OsAlarmAppModeRef=/ActiveEcuC/Os/OSAUTOSTARTMODE
      OsAlarm_Systick_Core3: OsAlarmCounterRef=/ActiveEcuC/Os/systemtimer3
        OsAlarmAction
          OsAlarmCallback: OsAlarmCallbackName=FreeRTOS_Tick_Handler_Core3
        OsAlarmAutostart: OsAlarmAlarmTime=100000, OsAlarmCycleTime=100000, OsAlarmAutostartType=RELATIVE, OsAlarmAppModeRef=/ActiveEcuC/Os/OSAUTOSTARTMODE
      OsAlarm_Systick_Core4: OsAlarmCounterRef=/ActiveEcuC/Os/SystemTimer4
        OsAlarmAction
          OsAlarmCallback: OsAlarmCallbackName=FreeRTOS_Tick_Handler_Core4
        OsAlarmAutostart: OsAlarmAlarmTime=100000, OsAlarmCycleTime=100000, OsAlarmAutostartType=RELATIVE, OsAlarmAppModeRef=/ActiveEcuC/Os/OSAUTOSTARTMODE
      OsAlarm_Systick_Core5: OsAlarmCounterRef=/ActiveEcuC/Os/SystemTimer5
        OsAlarmAction
          OsAlarmCallback: OsAlarmCallbackName=FreeRTOS_Tick_Handler_Core5
        OsAlarmAutostart: OsAlarmAlarmTime=100000, OsAlarmCycleTime=100000, OsAlarmAutostartType=RELATIVE, OsAlarmAppModeRef=/ActiveEcuC/Os/OSAUTOSTARTMODE
    OsMemmoryMap
      rtfw (OsMemmapLayer): OsInternalLayer=true
    4 x OsCore:
      OsCore{0..3}: OsCoreBswApplicationRef=/ActiveEcuC/Os/SystemApplication_Core{0..3}
    Armv8rE3650 (OsPublishedInformation): OsKernelVersion=1.0.0, OsPlatformName=E3650
      OsDerivativeInformation: OsStackAlignment=4
        4 x OsPhysicalCore:
          OsPhysicalCore{0..3}: OsPhysicalCoreId={0..3}
        4 x OsHardWareTimer, all with OsHardWareTimerClockFrequency=24:
          GTM{0..3}: OsHardWareTimerChannel=GTM{0..3}
